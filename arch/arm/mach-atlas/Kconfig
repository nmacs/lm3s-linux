## arch/arm/mach-atlas/Kconfig
```kconfig
if ARCH_ATLAS

config MACH_ATLAS
	bool

menu "ATLAS board options"

config ATLAS_CPU_LED
	bool "Enable CPU LED support"
	depends on ARCH_ATLAS
	help
	  CPU LED support.

config UART_CLOCK_TICK_RATE
	int "UART peripheral clock tick rate"
	default 16000000
	help
	  Alternate UART clocking frequency. If 0 use CLOCK_TICK_RATE.

config ATLAS_POWER
	bool "Atlas power management driver"

endmenu

endif
```

## arch/arm/mach-lm3s/Kconfig
```kconfig
if ARCH_LM3S

choice
	prompt "Texas Instruments LM3SXXXX Processor"

config ARCH_LM3S1D21
	bool "LM3S1D21"
	select PLAT_STELLARIS
	help
	  Include support for the Texas Instruments ARCH_LM3S1D21 MCU.

endchoice

endif
```

## arch/arm/mach-lm3s1d21/Kconfig
```kconfig
if ARCH_LM3S1D21

config MACH_LM3S1D21
	bool
	default y
	select ARM_NVIC if CPU_V7M
	help
	  Include support for the Texas Instruments LM3S1D21 platform.

config MPU
	bool "Enable MPU"
	default n
	help
		Enable MPU support for LM3S controllers

endif
```

## arch/arm/mach-tm4c/Kconfig
```kconfig
if ARCH_TM4C

choice
	prompt "Texas Instruments TM4CXXXX Processor"

config ARCH_TM4C12
	bool "TM4C12"
	select PLAT_STELLARIS
	select ARCH_HAS_CPUFREQ
	help
	  Include support for the Texas Instruments ARCH_TM4C12 MCU.

endchoice

menu "TM4CXXXX Processor Features"

config CPU_FREQ_TM4C
	bool "CPUfreq support for TI TM4CXXXX MCUs"
	depends on CPU_FREQ

endmenu

endif
```

## arch/arm/plat-stellaris/Kconfig
```kconfig
if ARCH_LM3S || ARCH_TM4C

config PLAT_STELLARIS
	bool
	select CPU_V7M
	select ARM_NVIC
	select HAVE_CLK
	select COMMON_CLKDEV
	select GENERIC_TIME
	select GENERIC_CLOCKEVENTS
	select ARM_THUMB

menu "Texas Instruments Stellaris System-on-Chip"

config DISABLE_TIME_ADJUST
	bool "Disable time adjust"
	default n

config MPU
	bool "Enable MPU"
	default n
	help
	  Enable MPU support for Stellaris controllers

config STELLARIS_DMA
	bool "Enable DMA"
	default n
	help
	  Enable DMA in STELLARIS drivers.

config LEDS_TRIGGER_CPUIDLE
	bool "CPU Idle LED Trigger"
	default n
	depends on CPU_IDLE
	help
	  Enable CPU Idle LED Trigger. LED is on while CPU is active.

config COPY_TO_SRAM
	bool "Copy some code and data to SRAM"
	default n

config COPY_TO_SRAM_SIZE
	int "SRAM region size"
	default 1024
	depends on COPY_TO_SRAM

config STELLARIS_ADC
	bool "ADC support"

endmenu

endif
```

## fs/ecryptfs/Kconfig
```kconfig
config ECRYPT_FS
	tristate "eCrypt filesystem layer support (EXPERIMENTAL)"
	depends on EXPERIMENTAL && KEYS && CRYPTO
	select CRYPTO_ECB
	select CRYPTO_CBC
	select CRYPTO_MD5
	help
	  Encrypted filesystem that operates on the VFS layer.  See
	  <file:Documentation/filesystems/ecryptfs.txt> to learn more about
	  eCryptfs.  Userspace components are required and can be
	  obtained from <http://ecryptfs.sf.net>.

	  To compile this file system support as a module, choose M here: the
	  module will be called ecryptfs.

config ECRYPT_FS_XATTR
	bool "Extended attributes support"
	depends on ECRYPT_FS
	help
	  This option enables support of extended attributes.

config ECRYPT_FS_DEBUG
	bool "Enable debugging"
	depends on ECRYPT_FS
	help
	  This option enables eCryptFS debugging.
```
